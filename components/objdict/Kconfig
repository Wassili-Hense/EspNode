## components/objdict/Kconfig
```kconfig
menu "Object Dictionary"

    config OD_MAX_OBJECTS
        int "Maximum number of dynamic objects"
        range 4 255
        default 32
        help
            Size of the table of objects registered by the gateway (X13: OD_MAX_INDEX_LIST).
            Reducing the value drops the saved object list.

endmenu
```

## components/plc/Kconfig
```kconfig
menu "PLC"

    config PLC_PROGRAM_SIZE
        int "Program memory, bytes"
        range 4096 65536
        default 16384
        help
            Multiple of 4096. The "plc" partition must be at least this large.

    config PLC_RAM_WORDS
        int "Data memory, 32-bit words"
        range 256 2048
        default 1024
        help
            Global variables, merkers and the stack of the PLC program.

    config PLC_RW_WORDS
        int "Merker area, 32-bit words"
        range 16 2048
        default 256
        help
            Start of the data memory the gateway can read and write as merkers (M objects).
            Must not exceed PLC_RAM_WORDS.

endmenu
```

## main/Kconfig.projbuild
```kconfig
menu "EspNode"

    menu "MQTT-SN serial link"
        comment "Used when the cfg partition is missing or invalid"

        config ESPNODE_UART_PORT
            int "UART port"
            range 0 2
            default 0
            help
                UART0 is the USB port of devkits: the console is off (sdkconfig.defaults).
                For debugging with the console on UART0 choose UART1 or UART2.

        config ESPNODE_UART_TX_PIN
            int "TX GPIO"
            range 0 33
            default 1
            help
                On WROVER modules GPIO16/17 are used by PSRAM, choose other pins.

        config ESPNODE_UART_RX_PIN
            int "RX GPIO"
            range 0 39
            default 3

        config ESPNODE_UART_DE_PIN
            int "RS485 DE GPIO (-1 = plain UART)"
            range -1 33
            default -1
            help
                Driver enable of an RS485 transceiver (half duplex), DE and /RE tied together.

        config ESPNODE_UART_BAUD
            int "Baud rate"
            default 38400

    endmenu

    choice ESPNODE_LOG_GATEWAY
        prompt "Log to the gateway"
        default ESPNODE_LOG_GATEWAY_WARN
        help
            Lines of the ESP-IDF log from this level up go to the gateway, Enviriot writes them to its log
            (objects 0xFFE0..0xFFE3). Lines of MQTT-SN and of the links are never sent.

        config ESPNODE_LOG_GATEWAY_NONE
            bool "None"
        config ESPNODE_LOG_GATEWAY_ERROR
            bool "Error"
        config ESPNODE_LOG_GATEWAY_WARN
            bool "Warning"
        config ESPNODE_LOG_GATEWAY_INFO
            bool "Info"
    endchoice

    config ESPNODE_LOG_GATEWAY_LEVEL
        int
        default 4 if ESPNODE_LOG_GATEWAY_NONE
        default 3 if ESPNODE_LOG_GATEWAY_ERROR
        default 1 if ESPNODE_LOG_GATEWAY_INFO
        default 2

    config ESPNODE_HW_VERSION
        string "Hardware version"
        default "10"
        help
            Last two characters of the X13 declarer (device type). The declarer is
            "E1" (uC family E - ESP32, subtype 1) + PHY letters of the interfaces + this version.

    config ESPNODE_SW_VERSION
        string "Software version"
        default "400"
        help
            Three characters after '.' of the device type. A git tag vX.Y.Z replaces it with "XYZ"
            (main/CMakeLists.txt).

endmenu
```
